/*
 * Copyright (c) 2023 George Daniel Mangum
 *
 * SPDX-License-Identifier: Apache-2.0
 */

/dts-v1/;
#include <bouffalolab/bl706.dtsi>
#include "pinecil_v2-pinctrl.dtsi"

/ {
	model = "Pinecil v2";
	compatible = "pine64,pinecil";

	// This section is tying Zephyr functionality to the board / SoC
	chosen {
		zephyr,console = &uart0;
	//	zephyr,shell-uart = &uart0;
	//	zephyr,bt-mon-uart = &uart0;
	//	zephyr,bt-c2h-uart = &uart0;
	//	zephyr,sram = &sram0;
	//	zephyr,flash = &flash0;
	};
};


