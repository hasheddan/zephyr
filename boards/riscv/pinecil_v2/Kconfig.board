## boards/riscv/pinecil_v2/Kconfig.board
```kconfig
# Pinecil v2 board configuration

# Copyright (c) 2023 George Daniel Mangum
# SPDX-License-Identifier: Apache-2.0

config BOARD_PINECIL_V2
	bool "Pinecil v2 Board"
	depends on SOC_BL706
```

## boards/riscv/pinecil_v2/Kconfig.defconfig
```kconfig
# Pinecil v2 board configuration

# Copyright (c) 2023 George Daniel Mangum
# SPDX-License-Identifier: Apache-2.0

if BOARD_PINECIL_V2

config BOARD
	default "pinecil_v2"

endif # BOARD_PINECIL_V2
```

## boards/riscv/pinecil_v2/pinecil_v2_defconfig
```kconfig
# Copyright (c) 2023 George Daniel Mangum
# SPDX-License-Identifier: Apache-2.0

CONFIG_SOC_SERIES_BL7X=y
CONFIG_SOC_BL706=y
CONFIG_BOARD_PINECIL_V2=y

# enable GPIO
CONFIG_GPIO=y

# enable uart driver
CONFIG_SERIAL=y

# enable console
CONFIG_CONSOLE=y
CONFIG_UART_CONSOLE=y
```

## drivers/serial/Kconfig.bflb
```kconfig
# Copyright (c) 2023 George Daniel Mangum
# SPDX-License-Identifier: Apache-2.0

config UART_BFLB
	bool "Bouffalo Lab UART"
	default y
	select SERIAL_HAS_DRIVER
	help
	  Enable Bouffalo Lab UART serial driver
```

## dts/bindings/serial/bouffalolab,bl-uart.yaml
```yaml
description: Bouffalo Lab UART

compatible: "bouffalolab,bl-uart"

include: [uart-controller.yaml, pinctrl-device.yaml, reset-device.yaml]

properties:
  reg:
    required: true

  interrupts:
    required: true
```

## soc/riscv/riscv-privileged/bouffalolab_bl7/Kconfig.defconfig.bl706
```kconfig
# Bouffalo Lab BL706 MCU

# Copyright (c) 2023 George Daniel Mangum
# SPDX-License-Identifier: Apache-2.0

config SOC
	default "BL706"
	depends on SOC_BL706
```

## soc/riscv/riscv-privileged/bouffalolab_bl7/Kconfig.defconfig.series
```kconfig
# Nordic Semiconductor nRF51 MCU line

# Copyright (c) 2023 George Daniel Mangum
# SPDX-License-Identifier: Apache-2.0

if SOC_SERIES_BL7X

source "soc/riscv/riscv-privileged/bouffalolab_bl7/Kconfig.defconfig.bl7*"

config SOC_SERIES
	default "bouffalolab_bl7"

config NUM_IRQS
	default 127

endif # SOC_SERIES_BL7x
```

## soc/riscv/riscv-privileged/bouffalolab_bl7/Kconfig.series
```kconfig
# Bouffalo Lab 7 series

# Copyright (c) 2023 George Daniel Mangum
# SPDX-License-Identifier: Apache-2.0

config SOC_SERIES_BL7X
	bool "Bouffalo Lab 7 series MCU"
	select RISCV
	select SOC_FAMILY_RISCV_PRIVILEGED
	select RISCV_HAS_CLIC
	help
	  Enable support for BL7x MCU series
```

## soc/riscv/riscv-privileged/bouffalolab_bl7/Kconfig.soc
```kconfig
# Bouffalo Lab MCU series

# Copyright (c) 2023 George Daniel Mangum
# SPDX-License-Identifier: Apache-2.0

choice
	prompt "BL7x MCU Selection"
	depends on SOC_SERIES_BL7X

config SOC_BL706
	select RISCV_ISA_RV32I
	select RISCV_ISA_EXT_M
	select RISCV_ISA_EXT_A
	select RISCV_ISA_EXT_C
	bool "Bouffalo Lab BL706"

endchoice
```
